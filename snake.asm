list		p=16f877A	
#include	<p16f877A.inc>	
__CONFIG H'3F31'

; WDT, ossilatör gibi register ayarlar?
w_temp		EQU	0x7D		
status_temp	EQU	0x7E		
pclath_temp	EQU	0x7F	

GECIKME1 EQU 0x20    ;GEC?KME 1. DONGU
GECIKME2 EQU 0x21    ;GECIKME 2. DONGU
GECIKME3 EQU 0x22    ;GECIKME 3.DONGU
ARKAB	 EQU 0X35
ARKAC	 EQU 0X36
ORTAB 	 EQU 0X37	 
ORTAC 	 EQU 0X38    
BASB     EQU 0X39
BASC     EQU 0X40
USTTASMA EQU 0X41
ALTTASMA EQU 0X42
SOLTASMA EQU 0X43
SAGTASMA EQU 0X44

ORG 0X00
GOTO SETUP
ORG 0X04
GOTO KESME

SETUP
BANKSEL ADCON1
MOVLW 0X06
MOVWF ADCON1
BANKSEL TRISA
MOVLW B'11111111'
MOVWF TRISA
BANKSEL TRISB
CLRF TRISB
BANKSEL TRISC
CLRF TRISC
BANKSEL PORTB
CLRF PORTB
BANKSEL PORTC
CLRF PORTC
GOTO ILKKURULUM

ILKKURULUM
MOVLW B'10000000'
MOVWF USTTASMA
MOVLW B'00000001'
MOVWF ALTTASMA
MOVLW B'100000'
MOVWF SOLTASMA
MOVLW B'000001'
MOVWF SAGTASMA
MOVLW B'0001000';8 0000100
MOVWF ARKAB
MOVLW B'0000001'
MOVWF ARKAC
MOVLW B'0001000'
MOVWF ORTAB
MOVLW B'0000010'
MOVWF ORTAC
MOVLW B'0001000'
MOVWF BASB
MOVLW B'0000100'
MOVWF BASC

GOTO BASLA

BASLA
BCF STATUS,Z
BCF STATUS,C

BTFSS PORTA,0 ;YUKARI
CALL YUKARI
BTFSS PORTA,1 ;ASAGI
CALL ASAGI
BTFSS PORTA,2 ;SOL
CALL SOL
BTFSS PORTA,3 ;SAG
CALL SAG
CALL GECIKME

;arka kýsým
MOVF ARKAB,W
MOVWF PORTB
MOVF ARKAC,W
MOVWF PORTC
;
CALL GECIKME
;orta kýsým
MOVF ORTAB,W
MOVWF PORTB
MOVF ORTAC,W
MOVWF PORTC
;
CALL GECIKME
;baþ kýsým
MOVF BASB,W
MOVWF PORTB
MOVF BASC,W
MOVWF PORTC
CALL GECIKME
GOTO BASLA

YUKARI
MOVF ORTAB,W
MOVWF ARKAB
MOVF ORTAC,W
MOVWF ARKAC
MOVF BASB,W
MOVWF ORTAB
MOVF BASC,W
MOVWF ORTAC
BTFSC BASB,0
MOVF USTTASMA,W
BTFSC BASB,0
MOVWF BASB
RRF BASB,1
CALL BUTONGECIKME
RETURN

ASAGI
MOVF ORTAB,W
MOVWF ARKAB
MOVF ORTAC,W
MOVWF ARKAC
MOVF BASB,W
MOVWF ORTAB
MOVF BASC,W
MOVWF ORTAC
BTFSC BASB,6
MOVF ALTTASMA,W
BTFSC BASB,6
MOVWF BASB
RLF BASB,1
CALL BUTONGECIKME
RETURN

SOL
MOVF ORTAB,W
MOVWF ARKAB
MOVF ORTAC,W
MOVWF ARKAC
MOVF BASB,W
MOVWF ORTAB
MOVF BASC,W
MOVWF ORTAC
BTFSC BASC,0
MOVF SOLTASMA,W
BTFSC BASC,0
MOVWF BASC
RRF BASC,1
CALL BUTONGECIKME
RETURN

SAG
MOVF ORTAB,W
MOVWF ARKAB
MOVF ORTAC,W
MOVWF ARKAC
MOVF BASB,W
MOVWF ORTAB
MOVF BASC,W
MOVWF ORTAC
BTFSC BASC,5
MOVF SAGTASMA,W
BTFSC BASC,5
MOVWF BASC
RLF BASC,1
CALL BUTONGECIKME
RETURN

;<100 ms
GECIKME			
	MOVLW	0XE7
	MOVWF	GECIKME1	
	MOVLW	0X04            
	MOVWF	GECIKME2
DONGU1
	DECFSZ	GECIKME1,1
	goto	$+2
	DECFSZ	GECIKME2,1
	GOTO	DONGU1
	RETURN

;0.5 s
BUTONGECIKME			
	MOVLW	0X03           
	MOVWF	GECIKME1	
	MOVLW	0X18              
	MOVWF	GECIKME2
	MOVLW	0X02                  
	MOVWF	GECIKME3
DONGU2
	DECFSZ	GECIKME1,1
	GOTO	$+2
	DECFSZ	GECIKME2,1
	GOTO	$+2
	DECFSZ	GECIKME3,1
	GOTO	DONGU2
	NOP
	NOP
	NOP	
	RETURN


KESME           	; kesme vektoru
	movwf   w_temp            	; W n?n yedegini al
	movf	STATUS,w          	; Status un yedegini almak icin onu once W ya al
	movwf	status_temp       	; Status u yedek register '?na al
	movf	PCLATH,w	  		; PCLATH '? yedeklemek icin onu once W 'ya al
	movwf	pclath_temp	  		; PCLATH '? yedek register a al

	movf	pclath_temp,w	  	; Geri donmeden once tum yedekleri geri yukle
	movwf	PCLATH		  		
	movf    status_temp,w     	
	movwf	STATUS            	
	swapf   w_temp,f
	swapf   w_temp,w          	
	retfie                    	; Kesme 'den don
END
